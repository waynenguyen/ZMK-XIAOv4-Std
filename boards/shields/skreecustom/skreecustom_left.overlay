#include "skreecustom.dtsi"

&kscan0 {
    col-gpios
        = <&gpio1 7 GPIO_ACTIVE_HIGH> 
        , <&gpio1 14 GPIO_ACTIVE_HIGH>
        , <&gpio1 5 GPIO_ACTIVE_HIGH>
        , <&gpio1 13 GPIO_ACTIVE_HIGH> 
        , <&gpio1 3 GPIO_ACTIVE_HIGH> 
        , <&gpio1 12 GPIO_ACTIVE_HIGH>
        ;
};
